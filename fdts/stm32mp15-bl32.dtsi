// SPDX-License-Identifier: (GPL-2.0+ OR BSD-3-Clause)
/*
 * Copyright (c) 2020-2023, STMicroelectronics - All Rights Reserved
 */

/omit-if-no-ref/ &usbotg_hs;
/omit-if-no-ref/ &usbphyc;
/omit-if-no-ref/ &hash1;
/omit-if-no-ref/ &fmc;
/omit-if-no-ref/ &qspi;
/omit-if-no-ref/ &sdmmc1;
/omit-if-no-ref/ &sdmmc2;

/ {
	aliases {
		/delete-property/ mmc0;
		/delete-property/ mmc1;
	};
};
