/*
 * Copyright (c) 2020, ARM Limited. All rights reserved.
 *
 * SPDX-License-Identifier: BSD-3-Clause
 */

/* TPM Event Log Config */
tpm_event_log {
	compatible = "arm,tpm_event_log";

#if defined(NT_FW_CONFIG) && defined(SPD_opteed)
	tpm_event_log_sm_addr = <0x0 0x0>;
#endif
	tpm_event_log_addr = <0x0 0x0>;
	tpm_event_log_size = <0x0>;
};
