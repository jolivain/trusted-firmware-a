/*
 * Copyright (c) 2021, ARM Limited. All rights reserved.
 *
 * SPDX-License-Identifier: BSD-3-Clause
 */

#include <common/tbbr/tbbr_img_def.h>

/dts-v1/;

/ {
	dtb-registry {
		compatible = "fconf,dyn_cfg-dtb_registry";

		hw-config {
			load-address = <0x0 0x82000000>;
			max-size = <0x01000000>;
			id = <HW_CONFIG_ID>;
		};

		/*
		 * The NT firmware config is loaded at base of DRAM.
		 */
		nt_fw-config {
			load-address = <0x0 0x0>;
			max-size = <0x200>;
			id = <NT_FW_CONFIG_ID>;
		};
	};
};
