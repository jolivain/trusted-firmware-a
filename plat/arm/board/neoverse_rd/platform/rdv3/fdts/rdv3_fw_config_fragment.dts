/*
 * Copyright (c) 2024, Arm Limited. All rights reserved.
 *
 * SPDX-License-Identifier: BSD-3-Clause
 */
stmm {
	uuid = "eaba83d8-baaf-4eaf-8144-f7fdcbe544a7";
	load-address = <0xF4300000>;
	owner = "Plat";
};
